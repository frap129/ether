/* Copyright (c) 2014, The Linux Foundation. All rights reserved.
 *
 * This program is free software; you can redistribute it and/or modify
 * it under the terms of the GNU General Public License version 2 and
 * only version 2 as published by the Free Software Foundation.
 *
 * This program is distributed in the hope that it will be useful,
 * but WITHOUT ANY WARRANTY; without even the implied warranty of
 * MERCHANTABILITY or FITNESS FOR A PARTICULAR PURPOSE.  See the
 * GNU General Public License for more details.
 */


/dts-v1/;

#include "msm8992.dtsi"
#include "msm8992-pinctrl.dtsi"
#include "msm8992-mtp-fag-evt.dtsi"
#include "fih/fag/msm8992_fag_evt.dtsi"

/ {
	model = "Qualcomm Technologies, Inc. MSM8992 MTP FIH FAG";
	compatible = "qcom,msm8992-mtp", "qcom,msm8992", "qcom,mtp";
	qcom,board-id = <0xB0 0>;
};
