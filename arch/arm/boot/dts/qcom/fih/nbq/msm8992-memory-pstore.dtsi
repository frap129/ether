/*
   Pstore feature is used to replace last_kmsg feature since kernel 3.10.
*/

/{
	memory {
		pstore_reserve_mem: pstore_reserve_mem_region@0 {
		linux,reserve-contiguous-region;
		linux,reserve-region;
		linux,remove-completely;
		reg = <0x0 0x1F600000 0x0 0x00200000>;
		label = "pstore_reserve_mem";
		};
	};
};
