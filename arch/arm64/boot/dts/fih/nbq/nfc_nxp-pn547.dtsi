&i2c_6 { /* BLSP1 QUP6 */
	status = "ok";
	nxp-nfc@28 {
		compatible = "nxp,nfc";
		reg = <0x28>;
		interrupt-parent = <&msm_gpio>;
		interrupts = <29 0x1>;
		interrupt-names = "nfc_irq";
		pinctrl-names = "nfc_active","nfc_suspend";
		pinctrl-0 = <&nfc_int_active &nfc_disable_active>;
		pinctrl-1 = <&nfc_int_suspend &nfc_disable_suspend>;
		clocks = <&clock_rpm clk_bb_clk2_pin>;
		clock-names = "ref_clk";
		nxp_nfc,irq-gpio = <&msm_gpio 29 0>;
		nxp_nfc,ven-gpio = <&msm_gpio 115 0>;
		nxp_nfc,firm-gpio = <&msm_gpio 116 0>;
	};
};