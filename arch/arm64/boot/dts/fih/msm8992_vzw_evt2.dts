/* Copyright (c) 2014, The Linux Foundation. All rights reserved.
 *
 * This program is free software; you can redistribute it and/or modify
 * it under the terms of the GNU General Public License version 2 and
 * only version 2 as published by the Free Software Foundation.
 *
 * This program is distributed in the hope that it will be useful,
 * but WITHOUT ANY WARRANTY; without even the implied warranty of
 * MERCHANTABILITY or FITNESS FOR A PARTICULAR PURPOSE.  See the
 * GNU General Public License for more details.
 */


/dts-v1/;

#include "../qcom/msm8992.dtsi"
#include "../qcom/msm8992-pinctrl.dtsi"
#include "msm8992-mtp-vzw-evt2.dtsi"
#include "fih/nbq/msm8992_vzw_evt2.dtsi"
#include "fih/nbq/nfc_nxp-pn547.dtsi"
#include "fih/nbq/nbq-f1-touch-evt1c.dtsi"
/*#include "fih/nbq/msm8992-memory-pstore.dtsi"*/

/ {
	model = "Qualcomm Technologies, Inc. MSM8992 MTP FIH VZW EVT2";
	compatible = "qcom,msm8992-mtp", "qcom,msm8992", "qcom,mtp";
	qcom,board-id = <0xA7 0>;
};
