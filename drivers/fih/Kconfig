## drivers/fih/Kconfig
```kconfig
menu "Device Drivers for FIH"

source "drivers/fih/fpcfingerprint_tee/Kconfig"


endmenu
```

## drivers/fih/fpcfingerprint_tee/Kconfig
```kconfig
#
# Makefile for FPC fingerprint TEE driver.
#
config FIH_FPC_FP_TEE
	tristate "FPC fingerprint TEE support"
	depends on SPI_QUP
	depends on FB
	help
	  If you say yes here, you get support for FPC fingerprint TEE driver.
```

## drivers/platform/fih/Kconfig
```kconfig
# FIH configuration options

config MACH_FIH
	bool "FIH device"
	depends on ARCH_MSM
	help
	  Support for FIH products

menu "FIH board selection"

config MACH_FIH_NBQ
	bool "NBQ board"
	select MACH_FIH
	help
	  Support for FIH NBQ variant

endmenu
```

## drivers/usb/hd3ss3220/kconfig
```kconfig
config HD3SS3220_SUPPORT

	tristate "hd3ss3220 support"
	depends on I2C
	default n
```
